## CMakeLists.txt
```
cmake_minimum_required(VERSION 3.20.0)

find_package(Zephyr REQUIRED HINTS $ENV{ZEPHYR_BASE})
project(zephyr_moddable_xs)

set(APP_XS_GENERATED_DIR "" CACHE PATH "Generated XS C source directory")
set(TI_SIMPLELINK_SDK_DIR "" CACHE PATH "Path to TI SimpleLink SDK root")
set(TI_DRIVER_LIBRARIES "" CACHE STRING "Semicolon-separated TI driver libraries for the active board/toolchain")

if(APP_XS_GENERATED_DIR STREQUAL "")
    get_filename_component(APP_BUILD_PARENT_DIR "${CMAKE_BINARY_DIR}" DIRECTORY)
    set(APP_XS_GENERATED_DIR "${APP_BUILD_PARENT_DIR}/xs")
endif()

file(GLOB APP_SOURCES CONFIGURE_DEPENDS
    ${CMAKE_CURRENT_SOURCE_DIR}/src/*.c
    ${CMAKE_CURRENT_SOURCE_DIR}/drivers/*.c
)

target_sources(app PRIVATE ${APP_SOURCES})

target_include_directories(app PRIVATE
    ${CMAKE_CURRENT_SOURCE_DIR}/src
    ${CMAKE_CURRENT_SOURCE_DIR}/drivers
)

if(EXISTS "${APP_XS_GENERATED_DIR}")
    file(GLOB XS_GENERATED_SOURCES CONFIGURE_DEPENDS "${APP_XS_GENERATED_DIR}/*.c")
    if(XS_GENERATED_SOURCES)
        target_sources(app PRIVATE ${XS_GENERATED_SOURCES})
    endif()
endif()

if(NOT TI_SIMPLELINK_SDK_DIR STREQUAL "")
    target_include_directories(app PRIVATE ${TI_SIMPLELINK_SDK_DIR}/source)
endif()

if(NOT TI_DRIVER_LIBRARIES STREQUAL "")
    target_link_libraries(app PRIVATE ${TI_DRIVER_LIBRARIES})
endif()
```

## prj.conf
```kconfig
CONFIG_MAIN_STACK_SIZE=4096
CONFIG_HEAP_MEM_POOL_SIZE=16384
CONFIG_GPIO=y
CONFIG_SERIAL=y
CONFIG_CONSOLE=y
```

## boards/cc1352p1_launchxl.overlay
```dts
/ {
    aliases {
        led0 = &led0;
        sw0 = &btn0;
    };
};
```

## src/main.c
```c
#include "drivers/cc1352p1.h"

void xs_user_native_init(void);

void main(void)
{
    ti_cc1352p1_drivers_init();
    xs_user_native_init();
}
```

## src/user_native.c
```c
#if defined(__has_include)
#if __has_include("xs.h") && __has_include("xsmc.h")
#define HAVE_MODDABLE_XS 1
#endif
#endif

#ifdef HAVE_MODDABLE_XS
#include "xs.h"
#include "xsmc.h"
#include "drivers/cc1352p1.h"

void xs_user_hello(xsMachine *the)
{
    (void)the;
    xsmcSetString(xsResult, "hello from user native C");
}

void xs_board_drivers_ready(xsMachine *the)
{
    (void)the;
    xsmcSetBoolean(xsResult, ti_cc1352p1_drivers_ready());
}

void xs_user_native_init(void)
{
    xsmcDefine(xsGlobal, xsID("userHello"), xsFunction(xs_user_hello, 0), xsDefault, xsDontDelete | xsDontSet);
    xsmcDefine(xsGlobal, xsID("boardDriversReady"), xsFunction(xs_board_drivers_ready, 0), xsDefault, xsDontDelete | xsDontSet);
}
#else
void xs_user_native_init(void)
{
}
#endif
```
